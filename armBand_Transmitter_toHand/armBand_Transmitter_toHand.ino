#include <esp_now.h>
#include <WiFi.h>
#include <Wire.h>

uint8_t broadcastAddress[] = {0x6C, 0xC8, 0x40, 0x8A, 0x89, 0x58};

typedef struct struct_message {
  
    float Adest;
    float Bdest;
    float Cdest;
    float Ddest;
    float Edest;
    float Fdest;

} 
struct_message;
struct_message myData;
esp_now_peer_info_t peerInfo;

void OnDataSent(const uint8_t *mac_addr, esp_now_send_status_t status) {
  Serial.print("\r\nLast Packet Send Status:\t");
  Serial.println(status == ESP_NOW_SEND_SUCCESS ? "Delivery Success" : "Delivery Fail");
}

int manhDist(int trainPoint[], int newPoint[]){
  int dist = 0;
  for(int i=0;i<16;i++){
    dist = dist + abs(trainPoint[i]-newPoint[i]);
  }

  return (dist);
}

//pressure array variables
int line1 = 35;
int line2 = 34;
int line3 = 39;

int output1 = 13;
int output2 = 12;
int output3 = 14;
int output4 = 27;
int output5 = 26;
int output6 = 25;
int output7 = 33;
int output8 = 32;

int pressure1 = 0;
int pressure2 = 0;
int pressure3 = 0;

int avg;
int completeArray[16];


int trainData[200][16]= {

    {0,0,523,218,455,229,298,429,244,142,0,0,154,0,349,187},
    {0,0,284,98,350,402,326,289,386,459,0,0,347,80,456,291},
    {0,0,388,145,479,287,397,368,485,283,0,0,232,16,453,331},
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    {0,0,0,0,577,337,487,436,336,219,0,0,538,112,379,176}

 };

int trainLabels[200] = {

  1,2,3,4,1,2,3,4,1,2,3,4,1,2,3,4,1,2,3,4,   1,2,3,4,1,2,3,4,1,2,3,4,1,2,3,4,1,2,3,4,
  1,2,3,4,1,2,3,4,1,2,3,4,1,2,3,4,1,2,3,4,   1,2,3,4,1,2,3,4,1,2,3,4,1,2,3,4,1,2,3,4,
  1,2,3,4,1,2,3,4,1,2,3,4,1,2,3,4,1,2,3,4,   1,2,3,4,1,2,3,4,1,2,3,4,1,2,3,4,1,2,3,4,
  1,2,3,4,1,2,3,4,1,2,3,4,1,2,3,4,1,2,3,4,   1,2,3,4,1,2,3,4,1,2,3,4,1,2,3,4,1,2,3,4,
  1,2,3,4,1,2,3,4,1,2,3,4,1,2,3,4,1,2,3,4,   1,2,3,4,1,2,3,4,1,2,3,4,1,2,3,4,1,2,3,4
  };


//A is middle, B is pointer, C is ring, D is pinky, E is fold, F is digits
float AOpen  = 10.6,  BOpen  = 10.2,  COpen  = 10.3, DOpen  = 9.5, EOpen  = 10.2, FOpen  = 0.8;
float AMid   = 9.5, BMid   = 9.0, CMid   = 11.4, DMid   = 10.5, EMid   = 9.8, FMid   = 0.35;
float AClose = 8.5, BClose = 7.9, CClose = 12.5,  DClose = 11.6, EClose = 9.5, FClose = 0.2;



void setup() {
  // put your setup code here, to run once:
  Serial.begin(115200);

  //led setup
  pinMode(2,OUTPUT);
  pinMode(15,OUTPUT);
  digitalWrite(2,LOW);
  digitalWrite(15,LOW);

  WiFi.mode(WIFI_STA);
  //initialize espNOW
  if (esp_now_init() != ESP_OK) {
    Serial.println("Error initializing ESP-NOW");
    return;
  }
  esp_now_register_send_cb(OnDataSent);

  // Register peer
  memcpy(peerInfo.peer_addr, broadcastAddress, 6);
  peerInfo.channel = 0;  
  peerInfo.encrypt = false;
  // Add peer        
  if (esp_now_add_peer(&peerInfo) != ESP_OK){
    Serial.println("Failed to add peer");
    return;
  }

  pinMode(line1,INPUT);
  pinMode(line2,INPUT);
  pinMode(line3,INPUT);

  pinMode(output1,OUTPUT);
  pinMode(output2,OUTPUT);
  pinMode(output3,OUTPUT);
  pinMode(output4,OUTPUT);
  pinMode(output5,OUTPUT);
  pinMode(output6,OUTPUT);
  pinMode(output7,OUTPUT);
  pinMode(output8,OUTPUT);

}

void loop() {
  // put your main code here, to run repeatedly:
  // set all outs to low initially
  digitalWrite(output1,LOW);
  digitalWrite(output2,LOW);
  digitalWrite(output3,LOW);
  digitalWrite(output4,LOW);
  digitalWrite(output5,LOW);
  digitalWrite(output6,LOW);
  digitalWrite(output7,LOW);
  digitalWrite(output8,LOW);

  delay(5);

  // read column 1
  digitalWrite (output1,HIGH);
  delay(5);
  completeArray[0] = analogRead (line2);  completeArray[1] = analogRead (line3);  
  delay(2);
  digitalWrite(output1,LOW);

  // read column 2
  digitalWrite (output2,HIGH);
  delay(5);
  completeArray[2] = analogRead (line2);  completeArray[3] = analogRead (line3); 
  delay(2);
  digitalWrite(output2,LOW);

  // read column 3
  digitalWrite (output3,HIGH);
  delay(5);
  completeArray[4] = analogRead (line2);  completeArray[5] = analogRead (line3);  
  delay(2);
  digitalWrite(output3,LOW);

  // read column 4
  digitalWrite (output4,HIGH);
  delay(5);
  completeArray[6] = analogRead (line2);  completeArray[7] = analogRead (line3); 
  delay(2);
  digitalWrite(output4,LOW);

  // read column 5
  digitalWrite (output5,HIGH);
  delay(5);
  completeArray[8] = analogRead (line2);  completeArray[9] = analogRead (line3); 
  delay(2);
  digitalWrite(output5,LOW);

  // read column 6
  digitalWrite (output6,HIGH);
  delay(5);
  completeArray[10] = analogRead (line2);  completeArray[11] = analogRead (line3); 
  delay(2);
  digitalWrite(output6,LOW);

  // read column 7
  digitalWrite (output7,HIGH);
  delay(5);
  completeArray[12] = analogRead (line2);  completeArray[13] = analogRead (line3); 
  delay(2);
  digitalWrite(output7,LOW);

  // read column 8
  digitalWrite (output8,HIGH);
  delay(5);
  completeArray[14] = analogRead (line2);  completeArray[15] = analogRead (line3);  
  delay(2);
  digitalWrite(output8,LOW);

  for (int i = 0; i<16; i++){ avg = avg + completeArray[i]; }
  avg = avg/16;


  //find distance between new point and all training data
  int distances[200];

  for (int i=0; i<200; i++){
    distances[i] = manhDist(trainData[i],completeArray);
  }
  //find  smallest distances (k=1)

  int smallestDist = distances[0];
  int smallestLabel = trainLabels[0];

  for (int i=0;i<200;i++){
    if (distances[i]<smallestDist){
      smallestDist = distances[i];
      smallestLabel = trainLabels[i];
    }

  }

  //change LEDs based on gesture
  if (smallestLabel == 1){ digitalWrite(15,LOW); digitalWrite(2,LOW);}    //open,  both off
  if (smallestLabel == 2){ digitalWrite(15,HIGH); digitalWrite(2,HIGH);}  // close, both on
  if (smallestLabel == 3){ digitalWrite(15,LOW); digitalWrite(2,HIGH);}   //point, blue on
  if (smallestLabel == 4){ digitalWrite(15,HIGH); digitalWrite(2,LOW);}   // pinch, red on

  float Adest = AOpen;
  float Bdest = BOpen; 
  float Cdest = COpen;
  float Ddest = DOpen;
  float Edest = EOpen;
  float Fdest = FOpen;

  if(smallestLabel == 1){Adest = AOpen; Bdest = BOpen; Cdest = COpen; Ddest = DOpen; Edest = EOpen; Fdest = FOpen;}
  if(smallestLabel == 2){Adest = AClose; Bdest = BClose; Cdest = CClose; Ddest = DClose; Edest = EClose; Fdest = FClose;}
  if(smallestLabel == 3){Adest = AClose; Bdest = BOpen; Cdest = CClose; Ddest = DClose; Edest = EOpen; Fdest = FClose;}
  if(smallestLabel == 4){Adest = AMid; Bdest = BMid; Cdest = COpen; Ddest = DOpen; Edest = EClose; Fdest = FMid;}

  myData.Adest = Adest; myData.Bdest = Bdest; myData.Cdest = Cdest; myData.Ddest = Ddest; myData.Edest = Edest; myData.Fdest = Fdest;

  esp_err_t result = esp_now_send(broadcastAddress, (uint8_t *) &myData, sizeof(myData));
  if (result == ESP_OK) {  Serial.println("Sent with success");  }
  else { Serial.println("Error sending the data");  }

  delay(10);

}



